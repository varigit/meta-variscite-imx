## conf/layer.conf
```bitbake
# We have a conf and classes directory, add to BBPATH
BBPATH .= ":${LAYERDIR}"

# We have a packages directory, add to BBFILES
BBFILES += "${LAYERDIR}/recipes-*/*/*.bb \
            ${LAYERDIR}/recipes-*/*/*.bbappend"

BBFILE_COLLECTIONS += "variscite-imx"
BBFILE_PATTERN_variscite-imx := "^${LAYERDIR}/"
BBFILE_PRIORITY_variscite-imx = "9"

# fix devil builds
BBMASK += "meta-fsl-bsp-release/imx/meta-sdk/recipes-graphics/devil/devil_%.bbappend"

LICENSE_PATH += "${LAYERDIR}/licenses"
```

## conf/machine/imx6ul-var-dart.conf
```bitbake
#@TYPE: Machine
#@NAME: Variscite i.MX6UL DART MX6
#@SOC: i.MX6UL

#@DESCRIPTION: Machine configuration for Variscite i.MX6UL DART MX6
#@MAINTAINER: Ron Donio <ron.d@variscite.com>
#

include conf/machine/include/imx-base.inc
include conf/machine/include/tune-cortexa7.inc

SOC_FAMILY = "mx7:mx6ul"
DEFAULTTUNE_mx6ul ?= "cortexa7hf-neon"

SDCARD_GENERATION_COMMAND_mx6ul = "generate_imx_sdcard"

SERIAL_CONSOLE = "115200 ttymxc0"
MACHINE_FEATURES += " pci bluetooth touchscreen wifi"

#
#
# UBIFS for Variscite NAND 0.5 GB
#
UBI_VOLNAME  = "rootfs"
MKUBIFS_ARGS = " -m 2048 -e 124KiB -c 3965 "
UBINIZE_ARGS = " -m 2048 -p 128KiB -s 2048 -O 2048 "
#
#
# UBIFS for Variscite NAND 1.0 GB
#
#UBI_VOLNAME  = "rootfs"
#MKUBIFS_ARGS = " -m 2048 -e 124KiB -c 7855 "
#UBINIZE_ARGS = " -m 2048 -p 128KiB -s 2048 -O 2048 "
#
MACHINE_SOCARCH_SUFFIX_mx6ul = "-mx6ul"

XSERVER_DRIVER_mx6ul = "xf86-video-fbdev"

# mx6 GPU libraries
PREFERRED_PROVIDER_virtual/egl_mx6ul = "mesa"
PREFERRED_PROVIDER_virtual/libgles1_mx6ul = "mesa"
PREFERRED_PROVIDER_virtual/libgles2_mx6ul = "mesa"
PREFERRED_PROVIDER_virtual/libgl_mx6ul = "mesa"
PREFERRED_PROVIDER_virtual/libg2d_mx6ul = ""

MACHINE_SOCARCH_FILTER_mx6ul = "libfslcodec libfslparser gst-fsl-plugins"

PREFERRED_VERSION_imx-kobs = "5.1"

# Variscite BSP default providers
#
PREFERRED_PROVIDER_virtual/kernel ?= "linux-variscite"
PREFERRED_PROVIDER_virtual/kernel_mx6 ?= "linux-variscite"
PREFERRED_PROVIDER_virtual/kernel_imx6ul-var-dart ?= "linux-variscite"
PREFERRED_VERSION_linux-imx_mx6 = "4.1.15"
KERNEL_DEVICETREE = "imx6ul-var-dart-emmc_wifi.dtb imx6ul-var-dart-sd_emmc.dtb imx6ul-var-dart-nand_wifi.dtb  imx6ul-var-dart-sd_nand.dtb"
#
PREFERRED_PROVIDER_u-boot = "u-boot-variscite"
PREFERRED_PROVIDER_u-boot_mx6ul = "u-boot-variscite"
PREFERRED_PROVIDER_u-boot_imx6ul-var-dart = "u-boot-variscite"
PREFERRED_PROVIDER_virtual/bootloader = "u-boot-variscite"

UBOOT_MAKE_TARGET = ""
SPL_BINARY = "SPL"
UBOOT_SUFFIX = "img"
UBOOT_CONFIG ??= "nand sd "
UBOOT_CONFIG[sd] = "mx6ul_var_dart_mmc_defconfig,sdcard"
UBOOT_CONFIG[nand] = "mx6ul_var_dart_nand_defconfig,ubifs"

IMAGE_FSTYPES = "tar.bz2 ext4 sdcard ubi"

PREFERRED_PROVIDER_wpa-supplicant-cli = "wpa-supplicant-wl18xx"
PREFERRED_PROVIDER_wpa-supplicant-passphrase = "wpa-supplicant-wl18xx"
PREFERRED_PROVIDER_wpa-supplicant = "wpa-supplicant-wl18xx"
```

## conf/machine/imx8mp-var-dart.conf
```bitbake
#@TYPE: Machine
#@NAME: Variscite DART-MX8M-PLUS
#@SOC: i.MX8MP
#@DESCRIPTION: Machine configuration for Variscite DART-MX8M-PLUS and VAR-SOM-MX8M-PLUS
#@MAINTAINER: Felix Radensky <felix.r@variscite.com>
#
# http://www.variscite.com

MACHINEOVERRIDES =. "mx8:mx8m:mx8mp:"

require conf/machine/include/imx-base.inc
require conf/machine/include/tune-cortexa53.inc

require variscite.inc

# Variscite BSP default providers
PREFERRED_PROVIDER_virtual/kernel_imx8mp-var-dart ?= "linux-variscite"

KERNEL_DEVICETREE = " \
	freescale/imx8mp-var-dart-dt8mcustomboard.dtb \
	freescale/imx8mp-var-dart-dt8mcustomboard-legacy.dtb \
	freescale/imx8mp-var-dart-dt8mcustomboard-m7.dtb \
	freescale/imx8mp-var-dart-dt8mcustomboard-legacy-m7.dtb \
	freescale/imx8mp-var-som-symphony.dtb \
	freescale/imx8mp-var-som-symphony-2nd-ov5640.dtb \
	freescale/imx8mp-var-som-symphony-m7.dtb \
	freescale/imx8mp-var-som-symphony-2nd-ov5640-m7.dtb \
"

WKS_FILE_DEPENDS_append = " imx-m7-demos"
IMAGE_BOOT_FILES += " \
	imx8mp_m7_TCM_hello_world.bin \
	imx8mp_m7_TCM_rpmsg_lite_pingpong_rtos_linux_remote.bin \
	imx8mp_m7_TCM_rpmsg_lite_str_echo_rtos.bin \
	imx8mp_m7_TCM_sai_low_power_audio.bin \
"

UBOOT_CONFIG ??= "sd"
UBOOT_CONFIG[sd] = "imx8mp_var_dart_config,sdcard"
SPL_BINARY = "spl/u-boot-spl.bin"

# Set DDR FIRMWARE
DDR_FIRMWARE_NAME = " \
	lpddr4_pmu_train_1d_dmem_202006.bin \
	lpddr4_pmu_train_1d_imem_202006.bin \
	lpddr4_pmu_train_2d_dmem_202006.bin \
	lpddr4_pmu_train_2d_imem_202006.bin \
"

# Set U-Boot DTB
UBOOT_DTB_NAME  = "imx8mp-var-dart-dt8mcustomboard.dtb"
UBOOT_DTB_EXTRA = "imx8mp-var-dart-dt8mcustomboard-legacy.dtb imx8mp-var-som-symphony.dtb"

# Set imx-mkimage boot target
IMXBOOT_TARGETS = "flash_evk"

SERIAL_CONSOLES = "115200;ttymxc0 115200;ttymxc1"

IMAGE_BOOTLOADER = "imx-boot"

ROOTFS_SIZE = "3700"
LOADADDR = ""
UBOOT_SUFFIX = "bin"
UBOOT_MAKE_TARGET = ""
IMX_BOOT_SEEK = "32"

PREFERRED_PROVIDER_u-boot_imx8mp-var-dart = "u-boot-variscite"
PREFERRED_PROVIDER_virtual/bootloader_imx8mp-var-dart = "u-boot-variscite"
```

## conf/machine/variscite-mirrors.inc
```bitbake
MIRRORS += "\
    git://anonscm.debian.org/.*   git://anonscm.debian.org/git/PATH;protocol=https \n \
    git://git.gnome.org/.*        git://git.gnome.org/browse/PATH;protocol=https \n \
    git://git.savannah.gnu.org/.* git://git.savannah.gnu.org/git/PATH;protocol=https \n \
    git://git.yoctoproject.org/.* git://git.yoctoproject.org/git/PATH;protocol=https \n \
    git://.*/.*                   git://HOST/PATH;protocol=https \n \
    git://source.codeaurora.org/external/imx/ git://github.com/nxp-imx/ \n \
    https://source.codeaurora.org/external/imx/ https://github.com/nxp-imx/ \n \
    http://source.codeaurora.org/external/imx/ http://github.com/nxp-imx/ \n \
    gitsm://source.codeaurora.org/external/imx/ gitsm://github.com/nxp-imx/ \n \
    ftp://nano-editor.org/pub/nano/ https://nano-editor.org/dist/ \n \
    http://sourceforge.net/projects/linuxptp/files/v1.6/ https://software-dl.ti.com/processor-sdk-mirror/sources \n \
    http://sourceforge.net/projects/linuxptp/files/v1.6/ https://variscite-public.nyc3.cdn.digitaloceanspaces.com/mirror/sources/ \n \
"
```
